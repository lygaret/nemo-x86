#define ASM_FILE 1
#include <defines.h>

ENTRY(_start)

SECTIONS {
    . = VIRT_BASE + PHYS_ADDR;

    .text ALIGN(4K) : AT(ADDR(.text) - VIRT_BASE) {
	    *(.multiboot)
	    *(.text*)
    }

    .data ALIGN(4K) : AT(ADDR(.data) - VIRT_BASE) {
        *(.data*)
    }

    .bss ALIGN(4K) : AT(ADDR(.bss) - VIRT_BASE) {
        _sbss = .;
        *(COMMON)
        *(.bss)
    }

    _kernend = . - VIRT_BASE;
}
